#include <stdint.h>
#include <string.h>
#include <stdio.h>
#include "esp_log.h"
#include "fips202.h"

static const char *TAG = "fips202_test";

static void test_sha3_256(void) {
    /* NIST FIPS 202 Appendix A, example message "abc". */
    static const uint8_t expected[32] = {
        0x3a, 0x98, 0x5d, 0xa7, 0x4f, 0xe2, 0x25, 0xb2, 0x04, 0x5c, 0x17,
        0x2d, 0x6b, 0xd3, 0x90, 0xbd, 0x85, 0x5f, 0x08, 0x6e, 0x3e, 0x9d,
        0x52, 0x5b, 0x46, 0xbf, 0xe2, 0x45, 0x11, 0x43, 0x15, 0x32,
    };

    const uint8_t msg[] = "abc";
    uint8_t out[32];
    sha3_256(out, msg, 3);

    if (memcmp(out, expected, sizeof(out)) == 0)
        ESP_LOGI(TAG, "SHA3-256 PASS");
    else
        ESP_LOGE(TAG, "SHA3-256 FAIL");
}

static void test_sha3_512(void) {
    /* NIST FIPS 202 Appendix B, example message "abc". */
    static const uint8_t expected[64] = {
        0xb7, 0x51, 0x85, 0x0b, 0x1a, 0x57, 0x16, 0x8a, 0x56, 0x93, 0xcd, 0x92, 0x4b,
        0x6b, 0x09, 0x6e, 0x08, 0xf6, 0x21, 0x82, 0x74, 0x44, 0xf7, 0x0d, 0x88, 0x4f,
        0x5d, 0x02, 0x40, 0xd2, 0x71, 0x2e, 0x10, 0xe1, 0x16, 0xe9, 0x19, 0x2a, 0xf3,
        0xc9, 0x1a, 0x7e, 0xc5, 0x76, 0x47, 0xe3, 0x93, 0x40, 0x57, 0x34, 0x0b, 0x4c,
        0xf4, 0x08, 0xd5, 0xa5, 0x65, 0x92, 0xf8, 0x27, 0x4e, 0xec, 0x53, 0xf0,
    };

    const uint8_t msg[] = "abc";
    uint8_t out[64];
    sha3_512(out, msg, 3);

    if (memcmp(out, expected, sizeof(out)) == 0)
        ESP_LOGI(TAG, "SHA3-512 PASS");
    else
        ESP_LOGE(TAG, "SHA3-512 FAIL");
}

static void test_shake256(void) {
    /* NIST SHAKE256 sample, message "abc", first 32 output bytes. */
    static const uint8_t expected[32] = {
        0x48, 0x33, 0x66, 0x60, 0x13, 0x60, 0xa8, 0x77, 0x1c, 0x68, 0x63,
        0x08, 0x0c, 0xc4, 0x11, 0x4d, 0x8d, 0xb4, 0x45, 0x30, 0xf8, 0xf1,
        0xe1, 0xee, 0x4f, 0x94, 0xea, 0x37, 0xe7, 0x8b, 0x57, 0x39,
    };

    const uint8_t msg[] = "abc";
    uint8_t out[32];
    shake256(out, sizeof(out), msg, 3);

    if (memcmp(out, expected, sizeof(out)) == 0)
        ESP_LOGI(TAG, "SHAKE256 PASS");
    else
        ESP_LOGE(TAG, "SHAKE256 FAIL");
}

void run_fips202_tests(void) {
    ESP_LOGI(TAG, "=== FIPS 202 tests ===");
    test_sha3_256();
    test_sha3_512();
    test_shake256();
    ESP_LOGI(TAG, "=== FIPS 202 tests done ===");
}
